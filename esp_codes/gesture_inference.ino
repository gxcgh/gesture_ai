#include <Wire.h>
#include "gesture_model.h" // Generated by emlearn from your training script

const uint8_t MPU6050_ADDR = 0x68;

// Must match the exact alpha value used during data collection!
float alpha = 0.2; 

// Filter variables
float filtered_ax = 0, filtered_ay = 0, filtered_az = 0;
float filtered_gx = 0, filtered_gy = 0, filtered_gz = 0;

// scikit-learn sorts class labels alphabetically
const char* class_names[] = {"back", "front", "left", "right"}; 

void setup() {
  Serial.begin(115200);
  while (!Serial) {
    delay(10);
  }

  // Initialize I2C on ESP32 DevKit V1 pins (SDA = 21, SCL = 22)
  Wire.begin(21, 22);

  // Wake up MPU6050
  Wire.beginTransmission(MPU6050_ADDR);
  Wire.write(0x6B);
  Wire.write(0x00);
  Wire.endTransmission();

  delay(100);

  // Prime the filter variables with an initial read
  Wire.beginTransmission(MPU6050_ADDR);
  Wire.write(0x3B); 
  Wire.endTransmission(false);
  Wire.requestFrom(MPU6050_ADDR, (uint8_t)14);
  if (Wire.available() == 14) {
    filtered_ax = (int16_t)((Wire.read() << 8) | Wire.read());
    filtered_ay = (int16_t)((Wire.read() << 8) | Wire.read());
    filtered_az = (int16_t)((Wire.read() << 8) | Wire.read());
    Wire.read(); Wire.read(); // Skip temp
    filtered_gx = (int16_t)((Wire.read() << 8) | Wire.read());
    filtered_gy = (int16_t)((Wire.read() << 8) | Wire.read());
    filtered_gz = (int16_t)((Wire.read() << 8) | Wire.read());
  }

  Serial.println("ESP32 Filtered Gesture Inference Initialized!");
}

void loop() {
  Wire.beginTransmission(MPU6050_ADDR);
  Wire.write(0x3B); 
  Wire.endTransmission(false);

  Wire.requestFrom(MPU6050_ADDR, (uint8_t)14);

  if (Wire.available() == 14) {
    // Read raw sensor values
    float raw_ax = (int16_t)((Wire.read() << 8) | Wire.read());
    float raw_ay = (int16_t)((Wire.read() << 8) | Wire.read());
    float raw_az = (int16_t)((Wire.read() << 8) | Wire.read());

    Wire.read(); Wire.read(); // Skip temperature bytes

    float raw_gx = (int16_t)((Wire.read() << 8) | Wire.read());
    float raw_gy = (int16_t)((Wire.read() << 8) | Wire.read());
    float raw_gz = (int16_t)((Wire.read() << 8) | Wire.read());

    // Apply the exact same filter equation used during data collection
    filtered_ax = (alpha * raw_ax) + ((1.0 - alpha) * filtered_ax);
    filtered_ay = (alpha * raw_ay) + ((1.0 - alpha) * filtered_ay);
    filtered_az = (alpha * raw_az) + ((1.0 - alpha) * filtered_az);
    
    filtered_gx = (alpha * raw_gx) + ((1.0 - alpha) * filtered_gx);
    filtered_gy = (alpha * raw_gy) + ((1.0 - alpha) * filtered_gy);
    filtered_gz = (alpha * raw_gz) + ((1.0 - alpha) * filtered_gz);

    // Package filtered features into the array
    //float features[6] = {filtered_ax, filtered_ay, filtered_az, filtered_gx, filtered_gy, filtered_gz};
    int16_t features[6] = {
      (int16_t)filtered_ax, (int16_t)filtered_ay, (int16_t)filtered_az,
      (int16_t)filtered_gx, (int16_t)filtered_gy, (int16_t)filtered_gz
    };
    // Run inference using the emlearn model function
    int predicted_class_idx = gesture_model_predict(features, 6);

    // Print prediction result
    Serial.print("Predicted Gesture: ");
    if (predicted_class_idx >= 0 && predicted_class_idx < 4) {
      Serial.println(class_names[predicted_class_idx]);
    } else {
      Serial.println("Unknown Class Index");
    }
  } else {
    Serial.println("Sensor read error!");
  }

  delay(50); // Match collection loop speed
}